## mcu/boards/modretro/m64/board.yml
```yaml
board:
  name: m64
  full_name: ModRetro M64 (STM32H7A3ZIT6)
  vendor: modretro
  socs:
    - name: stm32h7a3xx
```

## mcu/boards/modretro/m64/m64_defconfig
```kconfig
# SPDX-License-Identifier: Apache-2.0

# Enable MPU
CONFIG_ARM_MPU=y

# Enable hardware stack protection
CONFIG_HW_STACK_PROTECTION=y

# Enable GPIO
CONFIG_GPIO=y

# Enable serial / console
CONFIG_SERIAL=y
CONFIG_CONSOLE=y
CONFIG_UART_CONSOLE=y

# Enable clock control (STM32 clock configuration)
CONFIG_CLOCK_CONTROL=y

# Enable pin controller
CONFIG_PINCTRL=y
```
