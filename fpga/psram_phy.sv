`default_nettype none

// -----------------------------------------------------------------------------
// psram_phy - bidirectional byte-group PHY (x8) for the APS256.
//
// Extends the RX-proven psram_phy_bg with:
//   * DQ bits as RXTX_BITSLICE (drive C/A + writes; capture reads).
//   * TX_BITSLICE_TRI per nibble for 3-state control (TBYTE_IN path).
//   * tx_data[7:0] / tx_oe: parent drives the command/address byte and OE.
//   * CK / CE# generated by the parent (plain outputs, not through bitslices).
//
// Bring-up adds TX reset handling. RX_GATING=ENABLE / PHY_RDEN for gated reads
// (unchanged). PLL plane: CLKOUTPHY=800 MHz (VTC-safe), DQS DDR half-rate.
//
// This milestone (M4b-cmd step 1): convert DQ to RXTX, keep TX idle (tri high),
// verify synth + the RX capture path still works. Command drive wired but held
// off until step 2.
// -----------------------------------------------------------------------------

module psram_phy #(
  // DQS centering delay in IDELAY TAPS (COUNT mode, 0..511). No BISC/VTC, so
  // this is an uncalibrated raw tap count that must be tuned on hardware.
  parameter int DQS_TAPS = 0,
  // "TRUE" builds a datapath-diagnostic bitstream: every bitslice loops its
  // own TX output back to its RX input INSIDE the slice (O -> DATAIN, both
  // delay lines in the loop, IOB bypassed - UG861 Table 103). Combined with
  // the DQS slice driving an alternating pattern, strobe AND data are then
  // generated internally, so the capture path can be verified with no device
  // and no pins involved.
  parameter LOOPBACK = "FALSE"
) (
  input  wire        clk_app,          // control/command clock
  output wire        clk_cmd,          // 200 MHz PLL-derived cmd/CK clock
  input  wire        clk_pll_ref,
  input  wire        riu_clk,
  input  wire        rst,
  input  wire        rd_en,            // gated read window (PHY_RDEN)
  input  wire [8:0]  dqs_tap,          // DQS centering tap (COUNT, 0..511)
  input  wire [7:0]  strobe_pat,       // DQS-slice TX pattern (loopback strobe)
  input  wire [8:0]  tx_tap,           // C/A/write TX delay tap (aligns DQ to CK)
  input  wire        tx_tap_load,      // pulse to load tx_tap
  input  wire        dqs_tap_load,     // pulse to load dqs_tap
  output wire [8:0]  dqs_tap_cur,      // current tap (readback)
  input  wire [31:0] tx_beats,         // 4 C/A beats, one per TX serializer
                                       // beat: {beat3,beat2,beat1,beat0} bytes.
                                       // D[0] (beat0) is transmitted first.
  input  wire        tx_oe,            // 1 = drive DQ (C/A/write), 0 = Hi-Z (read)
  // PSRAM DQ pins (bidirectional)
  inout  wire [7:0]  dq_io,
  input  wire        dqs_pin,          // DQS input (capture only; device drives)
  output logic       phy_ready,
  output wire        pll_locked,
  output wire [31:0] dq_q,
  output wire [255:0] cap_words,       // 8 consecutive captured words (32 beats)
  // debug observability
  output wire [7:0]  dqs_as_data,      // the DQS strobe captured as DATA
  output wire [7:0]  dq_fifo_empty,    // per-DQ-pin RX FIFO empty
  output wire        dbg_cap_done,     // beat-aligned capture completed
  output wire        dbg_dly_rdy,
  output wire        dbg_vtc_rdy
);

  // ---- Clocking (per UG861 "Calculation of Required Frequencies", Ex.1) ----
  // Source-synchronous DDR: data rate = 2 x forwarded DQS, and PLL_CLK
  // (CLKOUTPHY) MUST equal the DATA RATE.
  //
  // Hard silicon limit: PLLE4 FVCO must be 750..1500 MHz. With
  // CLKOUTPHY_MODE="VCO_HALF" the lowest achievable CLKOUTPHY is ~375 MHz, so
  // the interface cannot be run slower than ~375 Mb/s with a rate-matched
  // PLL_CLK. We therefore run at the APS256's rated maximum:
  //   VCO = 100 MHz * 8 = 800 MHz
  //   CLKOUTPHY (VCO_HALF) = PLL_CLK = 400 MHz  = data rate (400 Mb/s)
  //   DQS = CK = 200 MHz  (device max)
  //   FIFO_RD_CLK = forwarded clock / 2 = 100 MHz
  //
  // PLL_CLK = 400 MHz is below the ~500 MHz needed for TIME-mode VTC, so the
  // delay lines run in COUNT mode (uncalibrated taps, EN_VTC=0, no IDELAYCTRL)
  // and BISC self-calibration is disabled. DQS centering is the fixed DQS_TAPS
  // value, which must be swept on hardware.
  wire pll_clk, pll_fb, pll_clkout0, pll_clkout1, riu_clk_int, clk_cmd_int;
  logic clkoutphyen;
  logic pll_rst, bsc_rst;
  wire  bsc_en_vtc = 1'b0;   // COUNT mode: VTC disabled
  wire  bs_en_vtc  = 1'b0;   // COUNT mode: bitslice EN_VTC low

  PLLE4_BASE #(
    .CLKFBOUT_MULT(8), .CLKIN_PERIOD(10.000),   // 100 MHz ref -> VCO 800 MHz
    .CLKOUT0_DIVIDE(8),                          // CLKOUT0 = 100 MHz (RIU + FIFO_RD)
    .CLKOUT1_DIVIDE(4),                          // CLKOUT1 = 200 MHz (cmd FSM + CK)
    .CLKOUTPHY_MODE("VCO_HALF"),                 // CLKOUTPHY = VCO/2 = 400 MHz
    .DIVCLK_DIVIDE(1)
  ) pll (
    .CLKFBOUT(pll_fb), .CLKOUT0(pll_clkout0), .CLKOUT0B(),
    .CLKOUT1(pll_clkout1), .CLKOUT1B(),
    .CLKOUTPHY(pll_clk), .LOCKED(pll_locked),
    .CLKFBIN(pll_fb), .CLKIN(clk_pll_ref), .CLKOUTPHYEN(clkoutphyen),
    .PWRDWN(1'b0), .RST(pll_rst)
  );
  BUFG bufg_riu (.I(pll_clkout0), .O(riu_clk_int));
  // 200 MHz command/CK clock from the SAME PLL as CLKOUTPHY. CK and the C/A
  // data are therefore phase-related by construction. Previously CK came from
  // the MMCM while DQ was serialized by CLKOUTPHY, two unrelated trees that
  // were additionally declared asynchronous - so the phase at which the device
  // sampled the instruction was arbitrary and never checked (Slack: inf).
  BUFG bufg_cmd (.I(pll_clkout1), .O(clk_cmd_int));
  assign clk_cmd = clk_cmd_int;

  // Everything in the data path now derives from this one PLL:
  //   CLKOUTPHY = 400 MHz  PLL_CLK (bitslice serializer/deserializer)
  //   CLKOUT1   = 200 MHz  command FSM + CK generation
  //   CLKOUT0   = 100 MHz  FIFO_RD_CLK (= DQS/2) and RIU_CLK
  wire clk_fifo = riu_clk_int;

  wire dly_rdy_u, dly_rdy_l, vtc_rdy_u, vtc_rdy_l;
  wire dly_rdy = dly_rdy_u & dly_rdy_l;
  wire vtc_rdy = vtc_rdy_u & vtc_rdy_l;
  wire [3:0] phy_rden = {4{rd_en & phy_ready}};
  // Combinational block 3-state (TBYTE_CTL="T"): drive DQ (low) only when the
  // controller asserts tx_oe after bring-up; else Hi-Z (high) so the device
  // drives during reads. No TX_BITSLICE_TRI / TBYTE serialization needed.
  wire dq_tri = ~(tx_oe & phy_ready);

  wire [39:0] rx_co_u [0:6], rx_ci_u [0:6], tx_co_u [0:6], tx_ci_u [0:6];
  wire [39:0] rx_co_l [0:6], rx_ci_l [0:6], tx_co_l [0:6], tx_ci_l [0:6];
  wire [39:0] tx_tri_co_u, tx_tri_co_l;   // TRI control-out from BSC (unused: TBYTE_CTL="T")
  wire pclk_u2l, nclk_u2l;

  // ======================= UPPER NIBBLE =====================================
  BITSLICE_CONTROL #(
    .DIV_MODE("DIV2"), .REFCLK_SRC("PLLCLK"),
    .RX_GATING("ENABLE"),
    .RX_CLK_PHASE_P("SHIFT_0"), .RX_CLK_PHASE_N("SHIFT_0"),
    .SELF_CALIBRATE("DISABLE"), .SERIAL_MODE("FALSE"),
    .EN_OTHER_PCLK("FALSE"), .EN_OTHER_NCLK("FALSE"),
    .SIM_DEVICE("ULTRASCALE_PLUS")
  ) bsc_u (
    .DLY_RDY(dly_rdy_u), .VTC_RDY(vtc_rdy_u),
    .CLK_TO_EXT_NORTH(), .CLK_TO_EXT_SOUTH(), .DYN_DCI(),
    .NCLK_NIBBLE_OUT(nclk_u2l), .PCLK_NIBBLE_OUT(pclk_u2l),
    .RIU_RD_DATA(), .RIU_VALID(),
    .RX_BIT_CTRL_OUT0(rx_co_u[0]), .RX_BIT_CTRL_OUT1(rx_co_u[1]),
    .RX_BIT_CTRL_OUT2(rx_co_u[2]), .RX_BIT_CTRL_OUT3(rx_co_u[3]),
    .RX_BIT_CTRL_OUT4(rx_co_u[4]), .RX_BIT_CTRL_OUT5(rx_co_u[5]),
    .RX_BIT_CTRL_OUT6(rx_co_u[6]),
    .TX_BIT_CTRL_OUT0(tx_co_u[0]), .TX_BIT_CTRL_OUT1(tx_co_u[1]),
    .TX_BIT_CTRL_OUT2(tx_co_u[2]), .TX_BIT_CTRL_OUT3(tx_co_u[3]),
    .TX_BIT_CTRL_OUT4(tx_co_u[4]), .TX_BIT_CTRL_OUT5(tx_co_u[5]),
    .TX_BIT_CTRL_OUT6(tx_co_u[6]), .TX_BIT_CTRL_OUT_TRI(tx_tri_co_u),
    .CLK_FROM_EXT(1'b1), .EN_VTC(bsc_en_vtc),
    .NCLK_NIBBLE_IN(1'b0), .PCLK_NIBBLE_IN(1'b0),
    .PHY_RDCS0(4'b0), .PHY_RDCS1(4'b0), .PHY_RDEN(phy_rden),
    .PHY_WRCS0(4'b0), .PHY_WRCS1(4'b0),
    .PLL_CLK(pll_clk), .REFCLK(1'b0),
    .RIU_ADDR(6'b0), .RIU_CLK(riu_clk_int), .RIU_NIBBLE_SEL(1'b0),
    .RIU_WR_DATA(16'b0), .RIU_WR_EN(1'b0), .RST(bsc_rst),
    .RX_BIT_CTRL_IN0(rx_ci_u[0]), .RX_BIT_CTRL_IN1(rx_ci_u[1]),
    .RX_BIT_CTRL_IN2(rx_ci_u[2]), .RX_BIT_CTRL_IN3(rx_ci_u[3]),
    .RX_BIT_CTRL_IN4(rx_ci_u[4]), .RX_BIT_CTRL_IN5(rx_ci_u[5]),
    .RX_BIT_CTRL_IN6(rx_ci_u[6]),
    .TBYTE_IN(4'b1111),
    .TX_BIT_CTRL_IN0(tx_ci_u[0]), .TX_BIT_CTRL_IN1(tx_ci_u[1]),
    .TX_BIT_CTRL_IN2(tx_ci_u[2]), .TX_BIT_CTRL_IN3(tx_ci_u[3]),
    .TX_BIT_CTRL_IN4(tx_ci_u[4]), .TX_BIT_CTRL_IN5(tx_ci_u[5]),
    .TX_BIT_CTRL_IN6(tx_ci_u[6]), .TX_BIT_CTRL_IN_TRI(40'b0)
  );

  // ======================= LOWER NIBBLE =====================================
  BITSLICE_CONTROL #(
    .DIV_MODE("DIV2"), .REFCLK_SRC("PLLCLK"),
    .RX_GATING("ENABLE"),
    .RX_CLK_PHASE_P("SHIFT_0"), .RX_CLK_PHASE_N("SHIFT_0"),
    .SELF_CALIBRATE("DISABLE"), .SERIAL_MODE("FALSE"),
    .EN_OTHER_PCLK("TRUE"), .EN_OTHER_NCLK("TRUE"),
    .SIM_DEVICE("ULTRASCALE_PLUS")
  ) bsc_l (
    .DLY_RDY(dly_rdy_l), .VTC_RDY(vtc_rdy_l),
    .CLK_TO_EXT_NORTH(), .CLK_TO_EXT_SOUTH(), .DYN_DCI(),
    .NCLK_NIBBLE_OUT(), .PCLK_NIBBLE_OUT(),
    .RIU_RD_DATA(), .RIU_VALID(),
    .RX_BIT_CTRL_OUT0(rx_co_l[0]), .RX_BIT_CTRL_OUT1(rx_co_l[1]),
    .RX_BIT_CTRL_OUT2(rx_co_l[2]), .RX_BIT_CTRL_OUT3(rx_co_l[3]),
    .RX_BIT_CTRL_OUT4(rx_co_l[4]), .RX_BIT_CTRL_OUT5(rx_co_l[5]),
    .RX_BIT_CTRL_OUT6(rx_co_l[6]),
    .TX_BIT_CTRL_OUT0(tx_co_l[0]), .TX_BIT_CTRL_OUT1(tx_co_l[1]),
    .TX_BIT_CTRL_OUT2(tx_co_l[2]), .TX_BIT_CTRL_OUT3(tx_co_l[3]),
    .TX_BIT_CTRL_OUT4(tx_co_l[4]), .TX_BIT_CTRL_OUT5(tx_co_l[5]),
    .TX_BIT_CTRL_OUT6(tx_co_l[6]), .TX_BIT_CTRL_OUT_TRI(tx_tri_co_l),
    .CLK_FROM_EXT(1'b1), .EN_VTC(bsc_en_vtc),
    .NCLK_NIBBLE_IN(nclk_u2l), .PCLK_NIBBLE_IN(pclk_u2l),
    .PHY_RDCS0(4'b0), .PHY_RDCS1(4'b0), .PHY_RDEN(phy_rden),
    .PHY_WRCS0(4'b0), .PHY_WRCS1(4'b0),
    .PLL_CLK(pll_clk), .REFCLK(1'b0),
    .RIU_ADDR(6'b0), .RIU_CLK(riu_clk_int), .RIU_NIBBLE_SEL(1'b0),
    .RIU_WR_DATA(16'b0), .RIU_WR_EN(1'b0), .RST(bsc_rst),
    .RX_BIT_CTRL_IN0(rx_ci_l[0]), .RX_BIT_CTRL_IN1(rx_ci_l[1]),
    .RX_BIT_CTRL_IN2(rx_ci_l[2]), .RX_BIT_CTRL_IN3(rx_ci_l[3]),
    .RX_BIT_CTRL_IN4(rx_ci_l[4]), .RX_BIT_CTRL_IN5(rx_ci_l[5]),
    .RX_BIT_CTRL_IN6(rx_ci_l[6]),
    .TBYTE_IN(4'b1111),
    .TX_BIT_CTRL_IN0(tx_ci_l[0]), .TX_BIT_CTRL_IN1(tx_ci_l[1]),
    .TX_BIT_CTRL_IN2(tx_ci_l[2]), .TX_BIT_CTRL_IN3(tx_ci_l[3]),
    .TX_BIT_CTRL_IN4(tx_ci_l[4]), .TX_BIT_CTRL_IN5(tx_ci_l[5]),
    .TX_BIT_CTRL_IN6(tx_ci_l[6]), .TX_BIT_CTRL_IN_TRI(40'b0)
  );

  // ---- strobe RXTX_BITSLICE (upper nibble pos0) ----
  // This is an RXTX_BITSLICE rather than an RX_BITSLICE for two reasons:
  //   1. The DQS/DM pin is bidirectional - the controller has to drive it as DM
  //      during writes - so a TX path is needed in the final design anyway.
  //      UG861 lists RXTX_BITSLICE_0, so position 0 may be an RXTX slice.
  //   2. RX_BITSLICE has no LOOPBACK attribute (no transmitter), so with an
  //      RX_BITSLICE the strobe could never be generated internally. As an
  //      RXTX slice, LOOPBACK="TRUE" lets the TX drive an alternating 1010
  //      pattern that loops back to its own RX input and acts as the nibble
  //      clock - a self-contained strobe for datapath bring-up with no device
  //      and no pins involved.
  //
  // COUNT mode + VAR_LOAD so the DQS centering tap can be loaded at RUNTIME
  // (no BISC, so there is no automatic Align_Delay; the tap must be swept on
  // hardware - typical Align_Delay is ~45-65 taps per UG861).
  // T is tied high: we never drive the external DQS pin (the device owns it);
  // in loopback builds the path is internal so the pin does not matter.
  RXTX_BITSLICE #(
    .RX_DATA_TYPE("DATA_AND_CLOCK"), .RX_DATA_WIDTH(4), .TX_DATA_WIDTH(4),
    .RX_DELAY_FORMAT("COUNT"), .RX_DELAY_TYPE("VAR_LOAD"), .RX_DELAY_VALUE(DQS_TAPS),
    .TX_DELAY_FORMAT("COUNT"), .TX_DELAY_TYPE("FIXED"), .TX_DELAY_VALUE(0),
    .RX_UPDATE_MODE("ASYNC"), .TBYTE_CTL("T"),
    .LOOPBACK(LOOPBACK),
    .SIM_DEVICE("ULTRASCALE_PLUS")
  ) rx_dqs (
    .RX_CNTVALUEOUT(dqs_tap_cur), .TX_CNTVALUEOUT(),
    .FIFO_EMPTY(), .FIFO_WRCLK_OUT(), .O(), .T_OUT(),
    .Q(dqs_as_data), .RX_BIT_CTRL_OUT(rx_ci_u[0]), .TX_BIT_CTRL_OUT(tx_ci_u[0]),
    .D(strobe_pat), .T(1'b1), .TBYTE_IN(1'b1),
    .RX_CE(1'b0), .RX_CLK(clk_app), .RX_CNTVALUEIN(dqs_tap),
    .RX_EN_VTC(bs_en_vtc), .RX_INC(1'b0), .RX_LOAD(dqs_tap_load),
    .TX_CE(1'b0), .TX_CLK(clk_app), .TX_CNTVALUEIN(9'b0),
    .TX_EN_VTC(bs_en_vtc), .TX_INC(1'b0), .TX_LOAD(1'b0),
    .DATAIN(dqs_pin),
    .FIFO_RD_CLK(clk_fifo), .FIFO_RD_EN(1'b1),
    .RX_RST(bsc_rst), .RX_RST_DLY(bsc_rst),
    .TX_RST(bsc_rst), .TX_RST_DLY(bsc_rst),
    .RX_BIT_CTRL_IN(rx_co_u[0]), .TX_BIT_CTRL_IN(tx_co_u[0])
  );

  assign dbg_dly_rdy = dly_rdy;
  assign dbg_vtc_rdy = vtc_rdy;

  // (No TX_BITSLICE_TRI: using TBYTE_CTL="T" combinational block 3-state on the
  // RXTX_BITSLICE .T input instead of the serialized TBYTE_IN path. The BSC
  // TX_BIT_CTRL_OUT_TRI outputs are left unconnected and TX_BIT_CTRL_IN_TRI
  // tied to 0.)

  // ---- DQ RXTX_BITSLICEs + IOBUF ----
  // Native pad wiring (per wizard iobuf_top): IOBUF.I = RXTX.O (serial out),
  // IOBUF.T = RXTX.T_OUT (serial 3-state from TBYTE path), IOBUF.O = RXTX.DATAIN.
  wire [7:0] q_full [0:7];
  wire [31:0] dq_q_raw;

  // Per-bitslice registered copies of the TX delay tap. The tap bus fans out
  // to all 8 bitslices, and TX_CNTVALUEIN has a Min Skew requirement between
  // its bits (~90 ps); driving it straight from the slow bus domain across the
  // die violated that. A local register per bitslice gives each one its own
  // driver placed next to it.
  logic [8:0] tx_tap_r      [0:7];
  logic       tx_tap_load_r [0:7];
  always_ff @(posedge clk_app) begin
    for (int i = 0; i < 8; i++) begin
      tx_tap_r[i]      <= tx_tap;
      tx_tap_load_r[i] <= tx_tap_load;
    end
  end
  wire [7:0] bs_o, bs_t, bs_din;
  `define RXTX(INST, DQIDX, RXCI, RXCO, TXCI, TXCO) \
    RXTX_BITSLICE #( \
      .RX_DATA_TYPE("DATA"), .RX_DATA_WIDTH(4), .TX_DATA_WIDTH(4), \
      .RX_DELAY_FORMAT("COUNT"), .RX_DELAY_TYPE("FIXED"), .RX_DELAY_VALUE(0), \
      .TX_DELAY_FORMAT("COUNT"), .TX_DELAY_TYPE("VAR_LOAD"), .TX_DELAY_VALUE(0), \
      .TBYTE_CTL("T"), .LOOPBACK(LOOPBACK), .SIM_DEVICE("ULTRASCALE_PLUS") \
    ) INST ( \
      .FIFO_EMPTY(dq_fifo_empty[DQIDX]), .FIFO_WRCLK_OUT(), .O(bs_o[DQIDX]), .Q(q_full[DQIDX]), \
      .RX_BIT_CTRL_OUT(RXCI), .RX_CNTVALUEOUT(), .TX_BIT_CTRL_OUT(TXCI), \
      .TX_CNTVALUEOUT(), .T_OUT(bs_t[DQIDX]), \
      .D({tx_beats[24+DQIDX], tx_beats[16+DQIDX], tx_beats[8+DQIDX], tx_beats[DQIDX]}), .DATAIN(bs_din[DQIDX]), \
      .FIFO_RD_CLK(clk_fifo), .FIFO_RD_EN(fifo_rd_en_r), \
      .RX_BIT_CTRL_IN(RXCO), .RX_CE(1'b0), .RX_CLK(1'b0), .RX_CNTVALUEIN(9'b0), \
      .RX_EN_VTC(bs_en_vtc), .RX_INC(1'b0), .RX_LOAD(1'b0), \
      .RX_RST(bsc_rst), .RX_RST_DLY(bsc_rst), \
      .T(dq_tri), .TBYTE_IN(1'b1), \
      .TX_BIT_CTRL_IN(TXCO), .TX_CE(1'b0), .TX_CLK(clk_app), .TX_CNTVALUEIN(tx_tap_r[DQIDX]), \
      .TX_EN_VTC(bs_en_vtc), .TX_INC(1'b0), .TX_LOAD(tx_tap_load_r[DQIDX]), \
      .TX_RST(bsc_rst), .TX_RST_DLY(bsc_rst) ); \
    IOBUF INST``_buf (.I(bs_o[DQIDX]), .T(bs_t[DQIDX]), .O(bs_din[DQIDX]), .IO(dq_io[DQIDX]))

  // upper nibble data: pos1->dq1, pos2->dq5, pos3->dq7
  `RXTX(rxtx_dq1, 1, rx_ci_u[1], rx_co_u[1], tx_ci_u[1], tx_co_u[1]);
  `RXTX(rxtx_dq5, 5, rx_ci_u[2], rx_co_u[2], tx_ci_u[2], tx_co_u[2]);
  `RXTX(rxtx_dq7, 7, rx_ci_u[3], rx_co_u[3], tx_ci_u[3], tx_co_u[3]);
  // lower nibble data: pos0->dq2, pos1->dq0, pos2->dq4, pos3->dq3, pos5->dq6
  `RXTX(rxtx_dq2, 2, rx_ci_l[0], rx_co_l[0], tx_ci_l[0], tx_co_l[0]);
  `RXTX(rxtx_dq0, 0, rx_ci_l[1], rx_co_l[1], tx_ci_l[1], tx_co_l[1]);
  `RXTX(rxtx_dq4, 4, rx_ci_l[2], rx_co_l[2], tx_ci_l[2], tx_co_l[2]);
  `RXTX(rxtx_dq3, 3, rx_ci_l[3], rx_co_l[3], tx_ci_l[3], tx_co_l[3]);
  `RXTX(rxtx_dq6, 6, rx_ci_l[5], rx_co_l[5], tx_ci_l[5], tx_co_l[5]);

  assign rx_ci_u[4] = 40'b0; assign rx_ci_u[5] = 40'b0; assign rx_ci_u[6] = 40'b0;
  assign tx_ci_u[4] = 40'b0; assign tx_ci_u[5] = 40'b0; assign tx_ci_u[6] = 40'b0;
  assign rx_ci_l[4] = 40'b0; assign rx_ci_l[6] = 40'b0;
  assign tx_ci_l[4] = 40'b0; assign tx_ci_l[6] = 40'b0;

  // NOTE: a fabric register sampling the raw pin state is NOT possible here.
  // DRC REQP-1922: an RXTX_BITSLICE DATAIN pin cannot be driven by an IO that
  // also drives fabric - the bitslice must be the IBUF's single fanout. So the
  // pin voltage can only be observed through the bitslice itself.

  generate
    for (genvar a = 0; a < 4; a = a + 1) begin
      for (genvar b = 0; b < 8; b = b + 1) begin
        assign dq_q_raw[a*8+b] = q_full[b][a];
      end
    end
  endgenerate

  logic [7:0] dbg_q_full_0;
  logic [7:0] dbg_q_full_1;
  logic [7:0] dbg_q_full_2;
  logic [7:0] dbg_q_full_3;
  logic [7:0] dbg_q_full_4;
  logic [7:0] dbg_q_full_5;
  logic [7:0] dbg_q_full_6;
  logic [7:0] dbg_q_full_7;

  assign dbg_q_full_0 = q_full[0];
  assign dbg_q_full_1 = q_full[1];
  assign dbg_q_full_2 = q_full[2];
  assign dbg_q_full_3 = q_full[3];
  assign dbg_q_full_4 = q_full[4];
  assign dbg_q_full_5 = q_full[5];
  assign dbg_q_full_6 = q_full[6];
  assign dbg_q_full_7 = q_full[7];

  // ============== Deterministic FIFO read alignment ========================
  // Previously FIFO_RD_EN was tied high, so the deserializer FIFOs were read
  // continuously - including while empty - and the read pointer had no defined
  // relationship to the read burst. With the write side clocked by the GATED
  // DQS (only toggling during the burst) and the read side by a continuous
  // clock, every transaction landed on an arbitrary beat offset. On hardware
  // that showed up as rd_raw taking one of ~7 sliding-window values at random,
  // independent of the delay tap, and FIFO_EMPTY sometimes set / sometimes
  // clear at the same sample point.
  //
  // Fix: hold FIFO_RD_EN low until every lane reports data, then read one word
  // and latch it. That anchors beat 0 to the burst rather than to a clock
  // phase. The latched word is held until the next read window opens, so the
  // controller's sample instant no longer has to be cycle-accurate.
  wire        lanes_empty = |dq_fifo_empty;    // any lane still empty
  logic [1:0] arm_sync;
  logic       arm_prev;
  logic       fifo_rd_en_r, cap_done;
  logic [31:0] dq_q_cap;
  // Multi-word capture: because CE# stays low and CK keeps running for the
  // whole transaction, the device streams register data continuously and wraps
  // through the register space. A single 4-beat word is therefore just a narrow
  // slice of a repeating sequence. Latching 8 successive words (32 beats) lets
  // the whole sequence be inspected at once, so beat order, bit order and the
  // position of Data0 can be identified from the data instead of guessed.
  logic [31:0] cap_buf [0:7];
  logic [2:0]  cap_idx;
  logic        cap_full;

  always_ff @(posedge clk_fifo or posedge rst) begin
    if (rst) begin
      arm_sync     <= 2'b00;
      arm_prev     <= 1'b0;
      fifo_rd_en_r <= 1'b0;
      cap_done     <= 1'b0;
      dq_q_cap     <= 32'h0;
      cap_idx      <= 3'd0;
      cap_full     <= 1'b0;
    end else begin
      arm_sync <= {arm_sync[0], rd_en};       // read window, into this domain
      arm_prev <= arm_sync[1];
      if (!arm_sync[1]) begin
        // Window closed: disarm and reset the alignment state for next time.
        fifo_rd_en_r <= 1'b0;
        cap_done     <= 1'b0;
      end else begin
        // Window just opened: clear the holding register so that a transaction
        // which fails to capture reads back as zero instead of silently
        // returning the PREVIOUS transaction's data (which made cap_done
        // impossible to interpret).
        if (!arm_prev) begin
          dq_q_cap <= 32'h0;
          cap_idx  <= 3'd0;
          cap_full <= 1'b0;
          // Clear the whole buffer too, so words that are never filled read
          // back as zero instead of retaining the previous transaction's data.
          for (int k = 0; k < 8; k++) cap_buf[k] <= 32'h0;
        end
        // Armed: start reading as soon as all lanes have data.
        if (!lanes_empty) fifo_rd_en_r <= 1'b1;
        // Q is valid the cycle after FIFO_RD_EN goes high.
        if (fifo_rd_en_r) begin
          if (!cap_done) begin
            dq_q_cap <= dq_q_raw;             // first aligned word
            cap_done <= 1'b1;
          end
          if (!cap_full) begin                // stream of 8 consecutive words
            cap_buf[cap_idx] <= dq_q_raw;
            if (cap_idx == 3'd7) cap_full <= 1'b1;
            else                 cap_idx  <= cap_idx + 3'd1;
          end
        end
      end
    end
  end

  genvar w;
  generate for (w = 0; w < 8; w = w + 1) begin : gen_capw
    assign cap_words[w*32 +: 32] = cap_buf[w];
  end endgenerate

  // Held, beat-aligned capture. (Written in clk_fifo, read in clk_cmd;
  // both come from the same MMCM and the controller samples many cycles
  // later, so the value is stable by then.)
  assign dq_q      = dq_q_cap;
  assign dbg_cap_done = cap_done;

  // ======================= Bring-up FSM =====================================
  // COUNT mode / SELF_CALIBRATE=DISABLE: no BISC, so there is no DLY_RDY or
  // VTC_RDY to wait for. Sequence reduces to:
  //   release PLL reset -> wait LOCKED -> release bitslice/BSC resets ->
  //   wait >=64 cycles -> enable CLKOUTPHY -> ready.
  // (dly_rdy/vtc_rdy remain wired for observability but are not gating.)
  typedef enum logic [2:0] {
    B_RESET, B_PLL_LOCK, B_WAIT64, B_PHYEN, B_READY
  } bstate_t;
  bstate_t bstate;
  logic [7:0] bcnt;

  always_ff @(posedge clk_app or posedge rst) begin
    if (rst) begin
      bstate <= B_RESET; pll_rst <= 1'b1; bsc_rst <= 1'b1;
      clkoutphyen <= 1'b0; phy_ready <= 1'b0; bcnt <= '0;
    end else begin
      case (bstate)
        B_RESET:    begin pll_rst <= 1'b0; bstate <= B_PLL_LOCK; end
        B_PLL_LOCK: if (pll_locked) begin bsc_rst <= 1'b0; bcnt <= '0; bstate <= B_WAIT64; end
        B_WAIT64:   begin bcnt <= bcnt + 8'd1; if (bcnt == 8'd80) bstate <= B_PHYEN; end
        B_PHYEN:    begin clkoutphyen <= 1'b1; bcnt <= '0; bstate <= B_READY; end
        B_READY:    phy_ready <= 1'b1;
        default:    bstate <= B_RESET;
      endcase
    end
  end

endmodule
